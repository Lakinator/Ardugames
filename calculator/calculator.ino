//Made by Laki (lakinator.bplaced.net)

#include <Arduboy2.h>
 
Arduboy2 arduboy;

const unsigned char cursor[] PROGMEM = {
  0xdb, 0x81, 0x00, 0x81, 0x81, 0x00, 0x81, 0xdb,
};

int selected;
bool button_down;
int number, number2;

enum class CalcStates {
  INPUT_1, INPUT_2, END, ABOUT, PLUS, MINUS, MULT, DIV
};

CalcStates state, op;

bool showOperations;

/*
 *  NUMBER BUTTONS
 */
 
const int NUMBER_ANZAHL = 10;

const unsigned char n0[] PROGMEM = {
 0x00, 0x00, 0x18, 0x24, 0x24, 0x18, 0x00, 0x00,
};

const unsigned char n1[] PROGMEM = {
  0x00, 0x00, 0x08, 0x04, 0x3c, 0x3c, 0x00, 0x00,
};

const unsigned char n2[] PROGMEM = {
  0x00, 0x00, 0x34, 0x34, 0x2c, 0x2c, 0x00, 0x00,
};

const unsigned char n3[] PROGMEM = {
 0x00, 0x00, 0x24, 0x24, 0x34, 0x3c, 0x00, 0x00,
};

const unsigned char n4[] PROGMEM = {
 0x00, 0x00, 0x1c, 0x10, 0x38, 0x10, 0x00, 0x00,
};

const unsigned char n5[] PROGMEM = {
 0x00, 0x00, 0x2c, 0x34, 0x34, 0x00, 0x00, 0x00,
};

const unsigned char n6[] PROGMEM = {
 0x00, 0x00, 0x3c, 0x34, 0x34, 0x34, 0x00, 0x00,
};

const unsigned char n7[] PROGMEM = {
 0x00, 0x00, 0x04, 0x24, 0x14, 0x0c, 0x00, 0x00,
};

const unsigned char n8[] PROGMEM = {
 0x00, 0x00, 0x18, 0x2c, 0x34, 0x18, 0x00, 0x00,
};

const unsigned char n9[] PROGMEM = {
 0x00, 0x00, 0x2c, 0x2c, 0x2c, 0x3c, 0x00, 0x00,
};

const unsigned char* numbers[] = {
  n0, n1, n2, n3, n4, n5, n6, n7, n8, n9,
};

/*
 *  OPERATION BUTTONS
 */
 
const int OPERATION_ANZAHL = 6;

const unsigned char opPlus[] PROGMEM = {
  0x00, 0x00, 0x18, 0x3c, 0x3c, 0x18, 0x00, 0x00,
};

const unsigned char opMinus[] PROGMEM = {
  0x00, 0x00, 0x18, 0x18, 0x18, 0x18, 0x00, 0x00,
};

const unsigned char opMult[] PROGMEM = {
  0x00, 0x00, 0x00, 0x18, 0x18, 0x00, 0x00, 0x00,
};

const unsigned char opDiv[] PROGMEM = {
  0x00, 0x00, 0x20, 0x10, 0x08, 0x04, 0x00, 0x00,
};

const unsigned char opRes[] PROGMEM = {
  0x00, 0x00, 0x24, 0x24, 0x24, 0x24, 0x00, 0x00,
};

const unsigned char opDel[] PROGMEM = {
  0x00, 0x00, 0x3c, 0x24, 0x24, 0x24, 0x00, 0x00,
};

const unsigned char* operations[] = {
  opPlus, opMinus, opMult, opDiv, opRes, opDel,
};

/*
 * ABOUT IMAGE
 */
  
const unsigned char about_img[] PROGMEM = {
  0x00, 0x00, 0x00, 0x00, 0x00, 0x00, 0x00, 0x00, 0x00, 0x00, 0x00, 0x00, 0x00, 0x00, 0x00, 0x00,
  0x00, 0x00, 0x00, 0x00, 0x00, 0x00, 0x00, 0x00, 0x00, 0x00, 0x00, 0x00, 0x00, 0x00, 0x00, 0x00,
  0x00, 0x00, 0x00, 0x00, 0x00, 0x00, 0x00, 0x00, 0x00, 0x00, 0x00, 0x00, 0x00, 0x00, 0x00, 0x00,
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  0x00, 0x00, 0x00, 0x00, 0x00, 0x00, 0x00, 0x00, 0x00, 0x00, 0x00, 0x00, 0x00, 0x00, 0x00, 0x00,
};


/*
 * FUNCTIONS
 */

void reset();

/*
 * CODE
 */

void setup() {
  arduboy.begin();
  arduboy.setFrameRate(15);
  
  selected = 0;
  button_down = false;
  number = 0;
  number2 = 0;
  
  state = CalcStates::INPUT_1;
  op = CalcStates::PLUS;
  showOperations = false;
}

void loop() {
  if (!(arduboy.nextFrame()))
    return;

  arduboy.clear();
  
  //Buttons
  
  if (arduboy.notPressed(RIGHT_BUTTON + LEFT_BUTTON + A_BUTTON + UP_BUTTON + DOWN_BUTTON + B_BUTTON)) {
    button_down = false;
  }
  
  if (!button_down) {
    
    if ((state == CalcStates::ABOUT || state == CalcStates::END) && (
                                      arduboy.pressed(RIGHT_BUTTON)  ||
                                      arduboy.pressed(LEFT_BUTTON)   ||
                                      arduboy.pressed(A_BUTTON)      || 
                                      arduboy.pressed(UP_BUTTON)     ||
                                      arduboy.pressed(DOWN_BUTTON)   || 
                                      arduboy.pressed(B_BUTTON)
                                      )) 
    {
      reset();
      button_down = true;
      return;
    }
    
    
    if (arduboy.pressed(RIGHT_BUTTON)) {
      selected++;
      button_down = true;
    } else if (arduboy.pressed(LEFT_BUTTON)) {
      selected--;
      button_down = true;
    } else if (arduboy.pressed(DOWN_BUTTON)) {
      state = CalcStates::ABOUT;
      button_down = true;
    } else if (arduboy.pressed(A_BUTTON)) {
      
      if (showOperations) {
        switch (selected) {
          case 0:
            op = CalcStates::PLUS;
            state = CalcStates::INPUT_2;
            break;
          case 1:
            op = CalcStates::MINUS;
            state = CalcStates::INPUT_2;
            break;
          case 2:
            op = CalcStates::MULT;
            state = CalcStates::INPUT_2;
            break;
          case 3:
            op = CalcStates::DIV;
            state = CalcStates::INPUT_2;
            break;
          case 4:
            state = CalcStates::END;
            break;
          case 5:
            reset();
            break;
        }
        
      } else {
        
        if (state == CalcStates::INPUT_1) {
          
          if (number < 1000) {
            number *= 10;
            number += selected;
          }
          
        } else if (state == CalcStates::INPUT_2) {
          if (number2 < 1000) {
            number2 *= 10;
            number2 += selected;
          }
        }
        
      }
      
      button_down = true;
    } else if (arduboy.pressed(B_BUTTON)) {
      
      if (state == CalcStates::INPUT_1) {
        number -= number % 10;
        if (number >= 10) number /= 10;
      } else if (state == CalcStates::INPUT_2) {
        number2 -= number2 % 10;
        if (number2 >= 10) number2 /= 10;
      }
      
      button_down = true;
      
    } else if (arduboy.pressed(UP_BUTTON)) {
      selected = 0;
      
      if (showOperations) {
        showOperations = false;
      } else {
        showOperations = true;
      }
      
      button_down = true;
    }
    
    
    if (showOperations) {
      if (selected == -1) selected = OPERATION_ANZAHL - 1;
      selected = abs(selected) % OPERATION_ANZAHL;
    } else {
      if (selected == -1) selected = NUMBER_ANZAHL - 1;
      selected = abs(selected) % NUMBER_ANZAHL;
    }
    
  }
  
  
  //Drawing
  
  if (state == CalcStates::INPUT_1 || state == CalcStates::INPUT_2 || state == CalcStates::END) {
    if (showOperations) {
      
      for (int i = 0; i < OPERATION_ANZAHL; i++) {
      
        if (i == selected) {
          arduboy.drawBitmap((i*8), 56, cursor, 8, 8, WHITE);
        }
      
        arduboy.drawBitmap((i*8), 56, operations[i], 8, 8, WHITE);
      } 
      
    } else {
      for (int i = 0; i < NUMBER_ANZAHL; i++) {
      
        if (i == selected) {
          arduboy.drawBitmap((i*8), 56, cursor, 8, 8, WHITE);
        }
      
        arduboy.drawBitmap((i*8), 56, numbers[i], 8, 8, WHITE);
      } 
    }
    
    
    //arduboy.print("Nummer: ");
    arduboy.print(number);
    
    if (state == CalcStates::INPUT_2 || state == CalcStates::END) {
      switch (op) {
        default:
          arduboy.print(" ? ");
          break;
        case CalcStates::PLUS:
          arduboy.print(" + ");
          break;
        case CalcStates::MINUS:
          arduboy.print(" - ");
          break;
        case CalcStates::MULT:
          arduboy.print(" * ");
          break;
        case CalcStates::DIV:
          arduboy.print(" / ");
          break;
      }
        
      arduboy.print(number2);
      
      if (state == CalcStates::END) {
        arduboy.print("\r\n= ");
        
        switch (op) {
        default:
          arduboy.print("\r\n= ?");
          break;
        case CalcStates::PLUS:
          arduboy.print((static_cast<double>(number) + static_cast<double>(number2)));
          break;
        case CalcStates::MINUS:
          arduboy.print((static_cast<double>(number) - static_cast<double>(number2)));
          break;
        case CalcStates::MULT:
          arduboy.print((static_cast<double>(number) * static_cast<double>(number2)));
          break;
        case CalcStates::DIV:
          arduboy.print((static_cast<double>(number) / static_cast<double>(number2)));
          break;
      }
        
      }
      
    } 
  } else if (state == CalcStates::ABOUT) {
    arduboy.drawBitmap(0, 0, about_img, 128, 64, WHITE);
  }


  arduboy.display();
}


void reset() {
  selected = 0;
  number = 0;
  number2 = 0;
  state = CalcStates::INPUT_1;
  op = CalcStates::PLUS;
  showOperations = false;
}